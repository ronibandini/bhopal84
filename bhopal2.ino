/*!
Bhopal 84 gas detector
MIT License
Roni Bandini June 2022 - @RoniBandini
TinyML via Edge Impulse
Oled Screen VCC to Arduino 3.3v, GND to Arduino GND, SDA to A4, SCL to A5
MiCS-4514 Gravity Gas Sensor to Arduino 3.3v, GND, SDA to A4, SCL to A5
*/

#include "DFRobot_MICS.h"
#include <Bhopal84_inferencing.h>
#include <SPI.h>
#include <Wire.h>
#include <Adafruit_GFX.h>
#include <Adafruit_SSD1306.h>

#define CALIBRATION_TIME   3   

#define Mics_I2C_ADDRESS ADDRESS_0
DFRobot_MICS_I2C mics(&Wire, 0x75);

#define SCREEN_WIDTH 128  
#define SCREEN_HEIGHT 32  
#define OLED_RESET     -1  
#define SCREEN_ADDRESS 0x3C  
Adafruit_SSD1306 display(SCREEN_WIDTH, SCREEN_HEIGHT, &Wire, OLED_RESET);

#define imageWidthLogo 128
#define imageHeightLogo 32

const unsigned char bhopal [] PROGMEM = {
  0x00, 0x00, 0x00, 0x00, 0x00, 0x00, 0x00, 0x00, 0x00, 0x00, 0x00, 0x00, 0x00, 0x00, 0x00, 0x00, 
  0x00, 0x00, 0x00, 0x00, 0x00, 0x00, 0x00, 0x00, 0x00, 0x00, 0x00, 0x00, 0x00, 0x00, 0x00, 0x00, 
  0x00, 0x00, 0x00, 0x00, 0x00, 0x00, 0x00, 0x00, 0x00, 0x00, 0x00, 0x01, 0xff, 0xfc, 0x00, 0x00, 
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  0x00, 0x00, 0x00, 0x00, 0x00, 0x00, 0x00, 0x00, 0x00, 0x00, 0x00, 0x00, 0x00, 0x00, 0x00, 0x00
};

const unsigned char edge [] PROGMEM = {
  0x00, 0x00, 0x00, 0x00, 0x00, 0x00, 0x00, 0x00, 0x00, 0x00, 0x00, 0x00, 0x00, 0x00, 0x00, 0x00, 
  0x00, 0x00, 0x00, 0x00, 0x00, 0x00, 0x00, 0x00, 0x00, 0x00, 0x00, 0x00, 0x00, 0x00, 0x00, 0x00, 
  0x00, 0x00, 0x00, 0x00, 0x00, 0x00, 0x00, 0x00, 0x00, 0x00, 0x00, 0x00, 0x00, 0x00, 0x00, 0x00, 
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  0x00, 0x00, 0x00, 0x00, 0x00, 0x00, 0x00, 0x00, 0x00, 0x00, 0x00, 0x00, 0x00, 0x00, 0x00, 0x00
};

# define ADC_PIN   A0
# define POWER_PIN 10
# define pinBuzzer 2

int   measuresNumber=4;
int   measuresCounter=0;
int   measuresTimeFrame=1000; // 1.5 seconds
float defaultMin=50000;
int   printReadings=0;
float scoreLimit=0.85;

String line1="";
String line2="";

float co2Sum     = 0;
float ch4Sum     = 0; // not used
float c2H5OHSum  = 0;
float h2Sum      = 0;
float nh3Sum     = 0;
float no2Sum     = 0; // not used

float co2Min     = defaultMin;
float ch4Min     = defaultMin; 
float c2H5OHMin  = defaultMin;
float h2Min      = defaultMin;
float nh3Min     = defaultMin;
float no2Min     = defaultMin;

float co2Max     = 0;
float ch4Max     = 0;
float c2H5OHMax  = 0;
float h2Max      = 0;
float nh3Max     = 0;
float no2Max     = 0;

float co2Avg     = 0;
float ch4Avg     = 0;
float c2H5OHAvg  = 0;
float h2Avg      = 0;
float nh3Avg     = 0;
float no2Avg     = 0;

float myScoreHarmful = 0;
float myScoreRegular = 0;

// Axis array
float features[18];

int raw_feature_get_data(size_t offset, size_t length, float *out_ptr) {
    memcpy(out_ptr, features + offset, length * sizeof(float));
    return 0;
}

void printScreen(){

      display.clearDisplay();
      display.setCursor(0, 0); 
      display.setTextSize(1);            
      display.setTextColor(SSD1306_WHITE); 
      display.println("Bhopal 84");
      display.println("Roni Bandini"); 
      display.println(line1); 
      display.println(line2); 
      display.display(); 
}
  
// buzzer beep
void myBeep(){     
     tone(pinBuzzer, 349, 500);
     delay(500);                        
     tone(pinBuzzer, 200, 500);
     delay(150); 
     tone(pinBuzzer, 150, 500);
     delay(500);   
     noTone(pinBuzzer);
}


void setup()
{
    pinMode(pinBuzzer, OUTPUT);       
    
    // wait for serial  
    Serial.begin(115200);
    delay(5000);
    //while(!Serial);

    Serial.println("Bhopal 84");
    Serial.println("TinyML via Edge Impulse");
    Serial.println("Roni Bandini, June 2022");
    Serial.println("@RoniBandini");
    Serial.println("------------------------------------");

    if(!display.begin(SSD1306_SWITCHCAPVCC, SCREEN_ADDRESS)) {
        Serial.println(F("SSD1306 allocation failed"));
        for(;;); // Loop forever
    }

    display.clearDisplay();   
    display.drawBitmap(0, 0,  bhopal, imageWidthLogo, imageHeightLogo, 1); 
    display.display();   
    delay(3000);
    
    display.clearDisplay();   
    display.drawBitmap(0, 0,  edge, imageWidthLogo, imageHeightLogo, 1); 
    display.display();   
    delay(3000);

    while(!mics.begin()){
    Serial.println("No gas sensor detected");
    delay(1000);
  } Serial.println("Gas sensor connected");

   line1="Calibrating...";
   printScreen();    
   delay(2000);   

  uint8_t mode = mics.getPowerState();
  
  if(mode == SLEEP_MODE){
    mics.wakeUpMode();
    Serial.println("Wake up sensor success");
  }else{
    Serial.println("The sensor is waking up");
  }

   while(!mics.warmUpTime(CALIBRATION_TIME)){
    Serial.println("Calibrating...");
    delay(1000);
  }

   myBeep(); 
   
   line1="Sensor ready...";
   line2="";
   printScreen();    
   delay(2000); 
    
}


void loop()
{

    if (measuresCounter==measuresNumber){
    
      // reached limit, make calculations and inference
      
      measuresCounter=0;
  
      // average
      co2Avg    =co2Sum/measuresNumber;
      ch4Avg    =ch4Sum/measuresNumber;
      c2H5OHAvg =c2H5OHSum/measuresNumber;
      h2Avg     =h2Sum/measuresNumber;
      nh3Avg    =nh3Sum/measuresNumber;
      no2Avg    =no2Sum/measuresNumber;
  
  
      // normalize min
  
      if (co2Min==defaultMin) {co2Min=0;};
      if (ch4Min==defaultMin) {ch4Min=0;};
      if (c2H5OHMin==defaultMin) {c2H5OHMin=0;};
      if (h2Min==defaultMin) {h2Min=0;};
      if (nh3Min==defaultMin) {nh3Min=0;};
      if (no2Min==defaultMin) {no2Min=0;};
      
      // send to inference
  
       features[0] = co2Avg;
       features[1] = ch4Avg;
       features[2] = c2H5OHAvg;
       features[3] = h2Avg;
       features[4] = nh3Avg;
       features[5] = no2Avg;
        
       features[6]  = co2Min;
       features[7]  = ch4Min;
       features[8]  = c2H5OHMin;
       features[9]  = h2Min;
       features[10] = nh3Min;
       features[11] = no2Min;
  
       features[12] = co2Max;
       features[13] = ch4Max;
       features[14] = c2H5OHMax;
       features[15] = h2Max;
       features[16] = nh3Max;
       features[17] = no2Max;
  
  
       
      // Check no sensor readings
      
      if (features[0] ==0 and features[1] ==0 and features[2] ==0 and features[3] ==0){
        Serial.println("All gas readings 0");
  
         line1="All readings are 0";
         line2="No leaks detected";
         printScreen();  
         delay(2000);
                
        }
        else
        {
          Serial.println("Gas readings ok");
  
              
        
        if (sizeof(features) / sizeof(float) != EI_CLASSIFIER_DSP_INPUT_FRAME_SIZE) {
            ei_printf("The size of your 'features' array is not correct. Expected %lu items, but had %lu\n",
                EI_CLASSIFIER_DSP_INPUT_FRAME_SIZE, sizeof(features) / sizeof(float));
            delay(1000);
            return;
        }
      
        ei_impulse_result_t result = { 0 };
    
        // the features are stored into flash, and we don't want to load everything into RAM
        signal_t features_signal;
        features_signal.total_length = sizeof(features) / sizeof(features[0]);
        features_signal.get_data = &raw_feature_get_data;
    
        // invoke the impulse
        EI_IMPULSE_ERROR res = run_classifier(&features_signal, &result, false /* debug */);
        ei_printf("run_classifier returned: %d\n", res);
      
        if (res != 0) return;
    
        // print the predictions
        ei_printf("Predictions ");
        ei_printf("(DSP: %d ms., Classification: %d ms., Anomaly: %d ms.)",
            result.timing.dsp, result.timing.classification, result.timing.anomaly);
        ei_printf(": \n");
        ei_printf("[");
        
       for (size_t ix = 0; ix < EI_CLASSIFIER_LABEL_COUNT; ix++) {
              ei_printf("%.5f", result.classification[ix].value);
              
              #if EI_CLASSIFIER_HAS_ANOMALY == 1
                ei_printf(", ");
              #else
                if (ix != EI_CLASSIFIER_LABEL_COUNT - 1) {
                  ei_printf(", ");
                }
              #endif
         }
          
          #if EI_CLASSIFIER_HAS_ANOMALY == 1
              ei_printf("%.3f", result.anomaly);
          #endif
              ei_printf("]\n");

          myScoreRegular = 0;
          myScoreHarmful = 0;
          
          // human-readable predictions
          for (size_t ix = 0; ix < EI_CLASSIFIER_LABEL_COUNT; ix++) {
              ei_printf("    %s: %.5f\n", result.classification[ix].label, result.classification[ix].value);
  
              
              
  
               if (result.classification[ix].label=="regular"){
                myScoreRegular=result.classification[ix].value;                             
               } // regular

             
              
              if (result.classification[ix].label=="harmful"){
                myScoreHarmful=result.classification[ix].value;                                        
              } // harmful
  
             if (myScoreHarmful<scoreLimit and myScoreRegular<scoreLimit){
  
                    line1="Harmful : " + String(myScoreHarmful*100)+"%";
                    line2="Regular : " + String(myScoreRegular*100)+"%";
                    printScreen();    
              
              }
                                    
          } // iterate labels

           if (myScoreRegular>scoreLimit){
  
                  // regular gas detected
                  
                  myBeep();
                  
                  line1="Regular gas";
                  line2=String(myScoreRegular*100)+"%";
                  printScreen();    
  
                  delay(5000);
                  
          }

           if (myScoreHarmful>scoreLimit){
  
                    // harmful gas detected
                    
                    myBeep();
                    
                    line1="Harmful gas";
                    line2=String(myScoreHarmful*100)+"%";
                    printScreen();    
  
                    delay(5000);
                   
              }
          
          #if EI_CLASSIFIER_HAS_ANOMALY == 1
              ei_printf("    anomaly score: %.3f\n", result.anomaly);
          #endif
  
                  
          }// gas readings ok
  
      delay(2000);
  
       // reset counters
       co2Sum     = 0;
       ch4Sum     = 0;
       c2H5OHSum  = 0;
       h2Sum      = 0;
       nh3Sum     = 0;
       no2Sum     = 0;
           
       co2Min     = defaultMin;
       ch4Min     = defaultMin;
       c2H5OHMin  = defaultMin;
       h2Min      = defaultMin;
       nh3Min     = defaultMin;
       no2Min     = defaultMin;
      
       co2Max     = 0;
       ch4Max     = 0;
       c2H5OHMax  = 0;
       h2Max      = 0;
       nh3Max     = 0;
       no2Max     = 0;
  
       delay(measuresTimeFrame);

  }
  else
  {
    
    // increase sample counter
    measuresCounter++;

    // gets data from sensor
    float co2data     = mics.getGasData(CO);
    float ch4data     = mics.getGasData(CH4);
    float c2H5OHdata  = mics.getGasData(C2H5OH);
    float h2data      = mics.getGasData(H2);
    float nh3data     = mics.getGasData(NH3);
    float no2data     = mics.getGasData(NO2);

    // sum to calculate average
    co2Sum     = co2Sum+co2data;
    ch4Sum     = ch4Sum+ch4data;
    c2H5OHSum  = c2H5OHSum+c2H5OHdata;
    h2Sum      = h2Sum+h2data;
    nh3Sum     = nh3Sum+nh3data;
    no2Sum     = no2Sum+no2data;


    if (printReadings==1){
      
            Serial.println("----------------------- Plain Readings");
            Serial.print("Carbon Monoxide: ");
            Serial.print(co2data,1);
            Serial.println(" PPM");
        
            Serial.print("Methane: ");
            Serial.print(ch4data,1);
            Serial.println(" PPM");
            
            Serial.print("Ethanol: ");
            Serial.print(c2H5OHdata,1);
            Serial.println(" PPM");
          
            Serial.print("Hydrogen: ");
            Serial.print(h2data,1);
            Serial.println(" PPM");
          
            Serial.print("Amonia: ");
            Serial.print(nh3data,1);
            Serial.println(" PPM");
          
            Serial.print("Nitrogen Dioxide: ");
            Serial.print(no2data,1);
            Serial.println(" PPM");
            Serial.println("");
    } // print readings
    

    // higher than max
    
    if (co2data>co2Max){
      co2Max=co2data;      
      }

    if (ch4data>ch4Max){
      ch4Max=ch4data;      
      }

    if (c2H5OHdata>c2H5OHMax){
      c2H5OHMax=c2H5OHdata;      
      }  

    if (h2data>h2Max){
      h2Max=h2data;      
      } 

    if (nh3data>nh3Max){
      nh3Max=nh3data;      
      } 

    if (no2data>no2Max){
      no2Max=no2data;      
      } 

    // lower than min
    
    if (co2data>0 and (co2data<co2Min)){
      co2Min=co2data;      
      }

    if (ch4data>0 and (ch4data<ch4Min)){
      ch4Min=ch4data;      
      }

    if (c2H5OHdata>0 and (c2H5OHdata<c2H5OHMin)){
      c2H5OHMin=c2H5OHdata;      
      }  

    if (h2data>0 and (h2data<h2Min)){
      h2Min=h2data;      
      } 

    if (nh3data>0 and (nh3data<nh3Min)){
      nh3Min=nh3data;      
      } 

    if (no2data>0 and (no2data<no2Min)){
      no2Min=no2data;      
    } 
  
  
  }
  
 
  delay(measuresTimeFrame/measuresNumber);
  
}
